#pragma once
// V0.5 LAB: bounded queue and HTTPS uplink. Configure via NVS (gateway-cloud).
// The backend must explicitly allow unauthenticated Cloud Run IAM invocation;
// the application independently verifies the Bearer token.
#include <Arduino.h>
#include <WiFi.h>
#include <WiFiClientSecure.h>
#include <HTTPClient.h>
#include <Preferences.h>
#include <math.h>

namespace gateway_cloud {
struct Reading {
  String event_id, node_id, observed_at;
  bool has_voltage = false, has_temperature = false;
  float voltage_v = 0, temperature_c = 0;
};
static constexpr size_t kCapacity = 16;
// Shared storage: defined once in main.cpp, referenced from MyMesh.cpp.
#ifdef GATEWAY_CLOUD_DEFINE_STORAGE
Reading queue[kCapacity];
size_t head = 0, count = 0;
uint32_t next_attempt_ms = 0;
uint8_t failures = 0;
String endpoint, token, ca_pem;
bool enabled = false, configured = false;
#else
extern Reading queue[kCapacity];
extern size_t head, count;
extern uint32_t next_attempt_ms;
extern uint8_t failures;
extern String endpoint, token, ca_pem;
extern bool enabled, configured;
#endif
static void begin() {
  Preferences p;
  p.begin("gateway-cloud", true);
  endpoint = p.getString("url", "");
  token = p.getString("token", "");
  ca_pem = p.getString("ca", "");
  enabled = p.getBool("enabled", false);
  p.end();
  configured = endpoint.startsWith("https://") &&
      endpoint.endsWith("/v1/telemetry") && token.length() >= 24 &&
      ca_pem.indexOf("-----BEGIN CERTIFICATE-----") >= 0;
  Serial.printf("[CLOUD] configured=%s enabled=%s (secrets hidden)\n",
                configured ? "yes" : "no", enabled ? "yes" : "no");
}
static bool enqueue(const Reading &reading) {
  if (!reading.event_id.length() || !reading.node_id.length() ||
      !reading.observed_at.length() ||
      (!reading.has_voltage && !reading.has_temperature)) return false;
  if (count == kCapacity) {
    Serial.println("[CLOUD] queue full: newest reading dropped");
    return false;
  }
  queue[(head + count) % kCapacity] = reading;
  ++count;
  return true;
}
static void loop() {
  if (!enabled || !configured || !count || WiFi.status() != WL_CONNECTED) return;
  if ((int32_t)(millis() - next_attempt_ms) < 0) return;
  const Reading &r = queue[head];
  // A verified CA is mandatory. Never use setInsecure().
  WiFiClientSecure client;
  client.setCACert(ca_pem.c_str());
  client.setTimeout(3);
  HTTPClient http;
  http.setTimeout(3000);
  http.setConnectTimeout(3000);
  if (!http.begin(client, endpoint)) {
    Serial.println("[CLOUD] HTTPS setup failed");
  } else {
    http.addHeader("Content-Type", "application/json");
    http.addHeader("Authorization", String("Bearer ") + token);
    // Identifiers are generated by the firmware from constrained values.
    String json = "{\"event_id\":\"" + r.event_id +
      "\",\"node_id\":\"" + r.node_id +
      "\",\"observed_at\":\"" + r.observed_at + "\"";
    if (r.has_voltage && isfinite(r.voltage_v))
      json += ",\"voltage_v\":" + String(r.voltage_v, 3);
    if (r.has_temperature && isfinite(r.temperature_c))
      json += ",\"temperature_c\":" + String(r.temperature_c, 2);
    json += ",\"source\":\"meshcore\"}";
    int status = http.POST(json);
    http.end();
    if (status == 202) {
      Serial.printf("[CLOUD] accepted event=%s\n", r.event_id.c_str());
      head = (head + 1) % kCapacity;
      --count;
      failures = 0;
      next_attempt_ms = millis() + 1000UL;
      return;
    }
    Serial.printf("[CLOUD] POST status=%d; retained for retry\n", status);
  }
  if (failures < 8) ++failures;
  const uint32_t delay_ms = min(300000UL, 2000UL << failures);
  next_attempt_ms = millis() + delay_ms;
}
static size_t pending() { return count; }
} // namespace gateway_cloud
